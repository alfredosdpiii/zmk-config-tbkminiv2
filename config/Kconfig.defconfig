## config/Kconfig.defconfig
```kconfig
if SHIELD_CORNE_LEFT

    config ZMK_KEYBOARD_NAME
        default "TBK-Mini(L)"
        
    config ZMK_SPLIT_BLE_ROLE_CENTRAL
        default y

endif

if SHIELD_CORNE_RIGHT

    config ZMK_KEYBOARD_NAME
        default "TBK-Mini(R)"

endif

if SHIELD_CORNE_LEFT || SHIELD_CORNE_RIGHT

    config ZMK_SPLIT
        default y
    config_ZMK_SLEEP
        default y

endif

if ZMK_BLE || ZMK_SPLIT_BLE

config ZMK_BLE_INIT_PRIORITY
	int "BLE Init Priority"
	default 50

#ZMK_BLE || ZMK_SPLIT_BLE
endif
```
