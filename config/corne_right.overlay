// tbkmini_right.overlay

#include <dt-bindings/zmk/matrix_transform.h>

/ {
    chosen {
        zmk,kscan = &default_kscan;
        zmk,matrix_transform = &default_transform;
    };

    default_kscan: kscan {
        compatible = "zmk,kscan-gpio-matrix";
        label = "default_kscan";
        diode-direction = "col2row";
        
        
        row-gpios
            = <&pro_micro 19 (GPIO_ACTIVE_HIGH | GPIO_PULL_DOWN)>,
              <&pro_micro 18 (GPIO_ACTIVE_HIGH | GPIO_PULL_DOWN)>,
              <&pro_micro 15 (GPIO_ACTIVE_HIGH | GPIO_PULL_DOWN)>,
              <&pro_micro 14 (GPIO_ACTIVE_HIGH | GPIO_PULL_DOWN)>;

        col-gpios
            = <&pro_micro 9 GPIO_ACTIVE_HIGH>,
              <&pro_micro 8 GPIO_ACTIVE_HIGH>,
              <&pro_micro 7 GPIO_ACTIVE_HIGH>,
              <&pro_micro 6 GPIO_ACTIVE_HIGH>,
              <&pro_micro 5 GPIO_ACTIVE_HIGH>,
              <&pro_micro 4 GPIO_ACTIVE_HIGH>;
             
    };
    
    default_transform: matrix_transform {
        compatible = "zmk,matrix-transform";
        columns = <12>;
        rows = <4>;
        col-offset = <6>;
    };
};
